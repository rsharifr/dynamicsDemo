// ============================================================
//  Stepper Motor – Serial + BLE Control, with Live Gyro Streaming
//  Hardware: Arduino Nano 33 BLE Sense + DM542T (DM54T)
// ============================================================
//
//  WIRING
//  ──────
//  DM542T PUL+ → D9    (STEP pulse)
//  DM542T PUL- → GND
//  DM542T DIR+ → D8    (direction)
//  DM542T DIR- → GND
//  DM542T ENA+ → D7    (enable, active LOW – tie HIGH to always enable)
//  DM542T ENA- → GND
//
//  SERIAL COMMANDS (115200 baud, send with newline)
//  ─────────────────────────────────────────────────
//  F<speed>   – spin Forward  at <speed> steps/sec  e.g. F800
//  R<speed>   – spin Reverse  at <speed> steps/sec  e.g. R400
//  S          – Stop
//  E          – Enable both drivers (pulls ENA LOW)
//  D          – Disable both drivers (pulls ENA HIGH)
//  ?          – Print current status
//
//  Speed range: 1 – 20000 steps/sec (adjust MAX_SPEED as needed)
//  Microstep setting on DM542T affects real RPM.
//  At 200 steps/rev (full step) and 800 steps/sec → 4 rev/sec (240 RPM)
//
//  ACCELERATION
//  ────────────
//  The motor ramps smoothly from its current speed up to the
//  target speed (and back down to 0 when stopping) instead of
//  jumping instantly. This avoids stalling at low/start speeds
//  and reduces resonance-related vibration.
//  Adjust ACCEL_STEPS_PER_SEC2 below to make the ramp faster/slower.
//
//  BLE + IMU
//  ─────────
//  Same commands (F<n>, R<n>, S, E, D, ?) now work from EITHER:
//    - USB Serial (Serial Monitor), and/or
//    - BLE, by writing text to the "Motor Command" characteristic
//  The onboard gyroscope is read continuously and its angular
//  velocity (deg/sec, X/Y/Z) is sent out two ways:
//    - printed to USB Serial, and
//    - pushed over BLE via the "Gyro Data" characteristic (notify)
//  Connect with a generic BLE app (e.g. nRF Connect) to a device
//  named "StepperBLE", find the custom service, then:
//    - Subscribe (enable notifications) on the Gyro Data characteristic
//      to see live angular velocity.
//    - Write text like "F400" to the Motor Command characteristic
//      to control the motor remotely.
//
//  TIMING ARCHITECTURE
//  ────────────────────
//  STEP pulses are generated by a hardware timer interrupt (NRF52
//  Timer3), NOT by loop(). This means pulse timing stays rock-solid
//  and evenly spaced no matter what BLE/IMU/Serial are doing in
//  loop() — eliminating the choppiness that comes from sharing
//  one loop for both pulse generation and radio/sensor work.
//  loop() still handles: Serial/BLE commands, gyro reads, and the
//  speed ramp — it just updates the timer's interval/enabled state
//  rather than directly toggling the STEP pin itself.
//
//  SECOND MOTOR: LINEAR ACTUATOR (position-tracked)
//  ──────────────────────────────────────────────────
//  Wired to LEFT side of Arduino (opposite side from spin motor)
//  DM542T #2 PUL+ → A2 (~D16)
//  DM542T #2 PUL- → GND
//  DM542T #2 DIR+ → A1 (~D15)
//  DM542T #2 DIR- → GND
//  DM542T #2 ENA+ → A0 (~D14)  (active LOW)
//  DM542T #2 ENA- → GND
//
//  ACTUATOR COMMANDS
//  ──────────────────
//  M<mm>   – Move actuator by <mm> millimeters, e.g. M50 or M-20
//            (positive = "forward" direction, negative = reverse)
//  P       – Print current tracked actuator position (mm)
//  Z<mm>   – Recalibrate: tell the firmware the actuator is currently
//            physically at <mm> millimeters, e.g. Z50. Sets ZERO_POS_MM
//            so that reference is correct, and resets the raw step
//            count back to zero (new reference frame going forward).
//
//  IMPORTANT — CALIBRATE MM_PER_STEP BEFORE TRUSTING DISTANCES:
//  The actuator is belt-driven and MM_PER_STEP below is a PLACEHOLDER.
//  To calibrate: command a known step count, measure actual travel
//  with a ruler, then set MM_PER_STEP = (measured mm) / (steps sent).
//  See the calibration note next to MM_PER_STEP further down.
//
//  Actuator motion also ramps smoothly (separate accel state from
//  the spin motor) and runs on its own hardware timer (Timer4), so
//  both motors can move at the same time without affecting each
//  other's pulse timing, or the BLE/IMU work in loop().
//
//  REQUIRED LIBRARIES (install via Library Manager):
//    - ArduinoBLE
//    - Arduino_BMI270_BMM150   (Rev2 boards use BMI270/BMM150, NOT LSM9DS1)
//    - NRF52_MBED_TimerInterrupt   (by Khoi Hoang)
// ============================================================

#include <ArduinoBLE.h>
#include <Arduino_BMI270_BMM150.h>
#include "NRF52_MBED_TimerInterrupt.h"
#include <math.h>

// Hardware timer used for STEP pulse generation.
// Timer1 is used internally by the mbed core — Timer3/Timer4 are safe.
NRF52_MBED_Timer stepTimer(NRF_TIMER_3);

// Second hardware timer, dedicated to the linear actuator's pulses.
// Fully independent of stepTimer — both can run simultaneously.
NRF52_MBED_Timer actuatorTimer(NRF_TIMER_4);

// ── BLE service & characteristics ─────────────────────────────
// Custom 128-bit UUIDs (randomly generated for this project — any
// app will see these as a single custom service with two characteristics).
BLEService stepperService("19b10000-e8f2-537e-4f6c-d104768a1214");

// Motor command: phone/PC writes text commands here (e.g. "F400")
// BLEWrite | BLEWriteWithoutResponse supports both confirmed and
// unconfirmed writes so any BLE central (Python/nRF Connect) works.
BLEStringCharacteristic motorCommandChar(
  "19b10001-e8f2-537e-4f6c-d104768a1214",
  BLEWrite | BLEWriteWithoutResponse, 32);

// Gyro + accel data: board notifies subscribers with "gx,gy,gz,ax,ay,az"
// gyro in deg/sec, accel in g-force
BLEStringCharacteristic gyroDataChar(
  "19b10002-e8f2-537e-4f6c-d104768a1214",
  BLERead | BLENotify, 96);

// Actuator position: broadcasts current radius in mm as a float string.
// Updated every time a gyro/accel packet goes out (~10Hz), so Python
// always has a matched (ω, r) pair for computing v = ω × r.
BLEStringCharacteristic positionChar(
  "19b10003-e8f2-537e-4f6c-d104768a1214",
  BLERead | BLENotify, 32);

unsigned long lastGyroSendMs = 0;
const unsigned long GYRO_SEND_INTERVAL_MS = 100;  // ~10 Hz over BLE

// ── Pin definitions ─────────────────────────────────────────
const uint8_t PIN_STEP   = 9;   // STEP pulse output (spin motor)
const uint8_t PIN_DIR    = 8;   // DIR output (spin motor)
const uint8_t PIN_ENA    = 7;   // ENA output (spin motor, active LOW on DM542T)

const uint8_t ACT_PIN_STEP  = A2;  // STEP pulse output (actuator) — left side pin A2 (~D16)
const uint8_t ACT_PIN_DIR   = A1;  // DIR output (actuator)         — left side pin A1 (~D15)
const uint8_t ACT_PIN_ENA   = A0;  // ENA output (actuator)         — left side pin A0 (~D14)

// ── Motion parameters ────────────────────────────────────────
const long    MAX_SPEED  = 20000;  // steps/sec upper limit
const long    MIN_SPEED  = 1;      // steps/sec lower limit

// How quickly speed ramps up/down, in steps/sec per second.
// Bigger number = faster ramp (less smoothing). Smaller = gentler.
const float   ACCEL_STEPS_PER_SEC2 = 800.0;

// Speed below which we don't bother ramping — just snap to it.
// Helps the motor leave a dead stop without a long, draggy ramp
// from 0. Keep this near your motor's known minimum reliable speed.
const float   START_SPEED = 80.0;

// ── Actuator-specific parameters ─────────────────────────────
// PLACEHOLDER — replace once you've measured your actual belt/pulley setup.
// Calibration procedure:
//   1. Send something like "M100" with this placeholder value in place.
//   2. Measure the ACTUAL distance the carriage moved with a ruler.
//   3. New MM_PER_STEP = (measured mm) / (100mm * (old MM_PER_STEP inverse)),
//      or more simply: MM_PER_STEP_new = MM_PER_STEP_old * (commanded mm / measured mm).
//   4. Update the constant below and re-upload.
// Starting guess here assumes a GT2 belt (2mm pitch) on a 20-tooth pulley
// at full-step (200 steps/rev): (20 teeth * 2mm) / 200 steps = 0.2 mm/step.
// Calibrated: M215 produces 200mm real travel on this rig.
// MM_PER_STEP = (200.0 / 215.0) * 0.2 = 0.18605
// Min radius: 35mm, Max radius: 235mm, Total travel: 200mm
float MM_PER_STEP   = 0.18605;

// Physical position (mm) that corresponds to actPositionSteps == 0.
// Set to the known physical minimum on first run; recalibrated at
// runtime by the Z<mm> command (which also resets actPositionSteps
// to 0), so it stays accurate after a manual position correction.
float ZERO_POS_MM = 0.35;

const float   ACT_MAX_SPEED_STEPS = 4000;   // steps/sec upper limit for actuator
const float   ACT_ACCEL_STEPS_PER_SEC2 = 400.0;   // gentler ramp for small motor
const float   ACT_CRUISE_SPEED_STEPS = 600.0;  // conservative default for 17HS08-1004S

// ── State ────────────────────────────────────────────────────
volatile bool  motorRunning  = false;   // true while actively moving (ramping or at speed)
volatile bool  stopping      = false;   // true while ramping down to a full stop
volatile bool  dirForward    = true;

float  targetSpeed   = 0;   // steps/sec we are ramping toward
float  currentSpeed  = 0;   // steps/sec we are actually running at right now

unsigned long lastAccelMicros = 0;

// Serial input buffer
String inputBuffer = "";

// ── Actuator state ───────────────────────────────────────────
volatile bool   actMoving      = false;   // true while actively moving toward a target
volatile bool   actStopping    = false;   // true while ramping down at end of a move
volatile bool   actDirForward  = true;

float actTargetSpeed  = 0;   // steps/sec we are ramping toward
float actCurrentSpeed = 0;   // steps/sec we are actually running at right now

// Position tracking, in steps, relative to wherever Z was last sent
// (or relative to power-on if Z was never sent). Positive = forward
// direction. Updated by the ISR every pulse, so it's an exact count
// of pulses actually sent, not just commanded.
volatile long actPositionSteps = 0;

// How many more steps are needed to complete the current move,
// and which direction. The ISR decrements this every pulse and
// signals "done" by setting it to 0, at which point loop() ramps
// down to a stop.
volatile long actStepsRemaining = 0;

unsigned long actLastAccelMicros = 0;

// ── Timer ISR ────────────────────────────────────────────────
// Fires once per step at whatever interval applySpeedToTimer() last
// set. Does a fast HIGH/delay/LOW pulse directly inside the ISR —
// the pulse only needs to be ~2-5µs, short enough not to meaningfully
// delay anything else. This runs completely independent of loop(),
// so BLE/IMU/Serial work never affects pulse timing or spacing.
void stepISR() {
  digitalWrite(PIN_STEP, HIGH);
  delayMicroseconds(3);
  digitalWrite(PIN_STEP, LOW);
}

// Re-programs the timer to fire at the rate matching currentSpeed,
// or stops it entirely at zero speed. Called whenever currentSpeed
// changes (i.e. every ramp step in loop()).
void applySpeedToTimer() {
  if (currentSpeed > 0) {
    unsigned long intervalUs = (unsigned long)(1000000.0 / currentSpeed);
    if (intervalUs < 10) intervalUs = 10;   // safety floor
    stepTimer.setInterval(intervalUs, stepISR);
  } else {
    stepTimer.stopTimer();
  }
}

// ── Actuator ISR ─────────────────────────────────────────────
// Same idea as stepISR, but also: (1) counts steps taken toward the
// current move so loop() knows when to start ramping down, and
// (2) updates the absolute position counter every pulse, so position
// tracking is exact (driven by pulses actually sent, not just by
// however long we intended to run).
void actuatorStepISR() {
  digitalWrite(ACT_PIN_STEP, HIGH);
  delayMicroseconds(3);
  digitalWrite(ACT_PIN_STEP, LOW);

  actPositionSteps += actDirForward ? 1 : -1;

  if (actStepsRemaining > 0) {
    actStepsRemaining--;
  }
}

// Re-programs the actuator timer to fire at the rate matching
// actCurrentSpeed, or stops it entirely at zero speed.
void applySpeedToActuatorTimer() {
  if (actCurrentSpeed > 0) {
    unsigned long intervalUs = (unsigned long)(1000000.0 / actCurrentSpeed);
    if (intervalUs < 10) intervalUs = 10;   // safety floor
    actuatorTimer.setInterval(intervalUs, actuatorStepISR);
  } else {
    actuatorTimer.stopTimer();
  }
}

// ── BLE event handler ────────────────────────────────────────
// Called immediately by ArduinoBLE when a central writes to
// motorCommandChar — more reliable than polling written() in loop().
void onMotorCommandWritten(BLEDevice central, BLECharacteristic characteristic) {
  String cmd = motorCommandChar.value();
  cmd.trim();
  if (cmd.length() > 0) {
    Serial.print("BLE cmd: ");
    Serial.println(cmd);
    handleCommand(cmd);
  }
}

// ── Setup ────────────────────────────────────────────────────
void setup() {
  pinMode(PIN_STEP, OUTPUT);
  pinMode(PIN_DIR,  OUTPUT);
  pinMode(PIN_ENA,  OUTPUT);

  digitalWrite(PIN_STEP, LOW);
  digitalWrite(PIN_DIR,  HIGH);
  digitalWrite(PIN_ENA,  HIGH);   // Disabled at startup; enable with E

  pinMode(ACT_PIN_STEP,  OUTPUT);
  pinMode(ACT_PIN_DIR,   OUTPUT);
  pinMode(ACT_PIN_ENA,  OUTPUT);

  digitalWrite(ACT_PIN_STEP,  LOW);
  digitalWrite(ACT_PIN_DIR,   HIGH);
  digitalWrite(ACT_PIN_ENA,   HIGH);   // Disabled at startup; enable with E

  Serial.begin(115200);
  // Wait up to 2 seconds for a Serial Monitor connection.
  // If none appears (e.g. running on battery with no laptop),
  // continue anyway so BLE still initialises and advertises.
  unsigned long serialWaitStart = millis();
  while (!Serial && millis() - serialWaitStart < 2000) { ; }

  // ── IMU ──
  if (!IMU.begin()) {
    Serial.println("! Failed to initialize IMU — check board");
  } else {
    Serial.print("✓ IMU ready, gyro sample rate = ");
    Serial.print(IMU.gyroscopeSampleRate());
    Serial.println(" Hz");
    delay(500);   // let IMU settle before calibrating
    calibrateIMU();
  }

  // ── BLE ──
  if (!BLE.begin()) {
    Serial.println("! Failed to initialize BLE — check board");
  } else {
    BLE.setLocalName("StepperBLE");
    BLE.setAdvertisedService(stepperService);
    stepperService.addCharacteristic(motorCommandChar);
    stepperService.addCharacteristic(gyroDataChar);
    stepperService.addCharacteristic(positionChar);
    BLE.addService(stepperService);
    motorCommandChar.writeValue("");
    gyroDataChar.writeValue("0.00,0.00,0.00,0.000,0.000,0.000");
    positionChar.writeValue("0.00");
    // Register event handler — fires immediately when central writes
    // a command, more reliable than polling written() in loop()
    motorCommandChar.setEventHandler(BLEWritten, onMotorCommandWritten);
    BLE.advertise();
    Serial.println("✓ BLE advertising as \"StepperBLE\"");
  }

  printHelp();

  // One-time header line for Arduino Serial Plotter — must be
  // printed ONCE before any data lines, exactly this format.
  // Serial Plotter reads this to label each of the 6 graph traces.
  Serial.println("gx,gy,gz,ax,ay,az");
}

// ── Main loop ────────────────────────────────────────────────
void loop() {
  // 0. Let the BLE stack process connection events / writes
  BLE.poll();

  // 1. Handle incoming USB Serial characters
  while (Serial.available()) {
    char c = (char)Serial.read();
    if (c == '\n' || c == '\r') {
      if (inputBuffer.length() > 0) {
        handleCommand(inputBuffer);
        inputBuffer = "";
      }
    } else {
      inputBuffer += c;
    }
  }

  // 2. BLE command writes are handled by onMotorCommandWritten()
  //    event handler — no need to poll written() here.

  // 3. Read gyroscope and report angular velocity (Serial + BLE)
  updateGyro();

  // 4. Update the ramp (acceleration / deceleration)
  //    STEP pulses themselves are generated by the hardware timer
  //    ISR, completely independent of this loop's timing.
  updateRamp();

  // 5. Update the actuator's ramp / move-completion logic
  updateActuatorRamp();
}

// ── Gyroscope + Accelerometer handler ───────────────────────
// Outputs a clean CSV line: gx,gy,gz,ax,ay,az
// Compatible with Arduino Serial Plotter (Tools → Serial Plotter),
// Python/Excel (read as CSV), and BLE apps (split on comma).
// No labels mixed into the line — just numbers and a newline.
// ── IMU zero offsets ─────────────────────────────────────────
// Measured at startup by averaging 100 samples while stationary.
// Subtracted from every reading so the sensor reads true zero at rest.
// ── IMU corrections ──────────────────────────────────────────
// BMI270 on Nano 33 BLE Rev2 outputs ~1/7.69 of true g-force
// due to its default full-scale range — multiply by 7.69 to get real g.
// Gyro is zeroed at startup; accel is scaled but NOT gravity-corrected
// since the board rotates and gravity direction changes constantly.
// BMI270 on Nano 33 BLE Rev2 outputs directly in g-force units.
// Multiply by 9.81 to convert to m/s².
const float ACCEL_SCALE = 9.81;
float gyroOffX = 0, gyroOffY = 0, gyroOffZ = 0;

void calibrateIMU() {
  Serial.println("Calibrating gyro zero offset — keep still for 3 seconds...");
  // Discard first 50 samples — IMU needs a moment to fully settle
  int warmup = 0;
  while (warmup < 50) {
    if (IMU.gyroscopeAvailable()) {
      float gx, gy, gz;
      IMU.readGyroscope(gx, gy, gz);
      warmup++;
      delay(10);
    }
  }
  // Now average 300 samples for a more accurate zero
  const int samples = 300;
  float sgx=0, sgy=0, sgz=0;
  int count = 0;
  while (count < samples) {
    if (IMU.gyroscopeAvailable()) {
      float gx, gy, gz;
      IMU.readGyroscope(gx, gy, gz);
      sgx+=gx; sgy+=gy; sgz+=gz;
      count++;
      delay(10);
    }
  }
  gyroOffX = sgx/samples;
  gyroOffY = sgy/samples;
  gyroOffZ = sgz/samples;
  Serial.print("✓ Gyro offsets (deg/s): ");
  Serial.print(gyroOffX,3); Serial.print(", ");
  Serial.print(gyroOffY,3); Serial.print(", ");
  Serial.println(gyroOffZ,3);
}

void updateGyro() {
  if (!IMU.gyroscopeAvailable()) return;
  if (!IMU.accelerationAvailable()) return;

  float gx, gy, gz;
  float ax, ay, az;
  IMU.readGyroscope(gx, gy, gz);
  IMU.readAcceleration(ax, ay, az);

  // Zero gyro drift offset
  gx -= gyroOffX;  gy -= gyroOffY;  gz -= gyroOffZ;

  // Scale accel to real g-force — gravity stays in signal (correct for rotating rig)
  ax *= ACCEL_SCALE;
  ay *= ACCEL_SCALE;
  az *= ACCEL_SCALE;

  unsigned long now = millis();
  if (now - lastGyroSendMs < GYRO_SEND_INTERVAL_MS) return;
  lastGyroSendMs = now;

  // Serial: plain CSV for Serial Plotter
  Serial.print(gx, 2); Serial.print(",");
  Serial.print(gy, 2); Serial.print(",");
  Serial.print(gz, 2); Serial.print(",");
  Serial.print(ax, 3); Serial.print(",");
  Serial.print(ay, 3); Serial.print(",");
  Serial.println(az, 3);

  // BLE: same CSV string plus matched radius
  if (BLE.connected()) {
    char buf[96];
    snprintf(buf, sizeof(buf), "%.2f,%.2f,%.2f,%.3f,%.3f,%.3f",
             gx, gy, gz, ax, ay, az);
    gyroDataChar.writeValue(buf);
    char posBuf[32];
    snprintf(posBuf, sizeof(posBuf), "%.2f",
             ZERO_POS_MM + (float)actPositionSteps * MM_PER_STEP);
    positionChar.writeValue(posBuf);
  }
}

// ── Ramp handler ─────────────────────────────────────────────
// Moves currentSpeed toward targetSpeed at ACCEL_STEPS_PER_SEC2,
// and re-programs the hardware timer's interval to match. Called
// every loop() — the ISR itself just fires at whatever interval
// was last set here, independent of how often loop() runs.
void updateRamp() {
  unsigned long now = micros();
  if (lastAccelMicros == 0) lastAccelMicros = now;
  float dt = (now - lastAccelMicros) / 1000000.0;  // seconds since last update
  if (dt <= 0) return;
  lastAccelMicros = now;

  float previousSpeed = currentSpeed;

  float maxChange = ACCEL_STEPS_PER_SEC2 * dt;

  if (currentSpeed < targetSpeed) {
    currentSpeed = min(currentSpeed + maxChange, targetSpeed);
  } else if (currentSpeed > targetSpeed) {
    currentSpeed = max(currentSpeed - maxChange, targetSpeed);
  }

  // Finished ramping down to zero -> fully stopped
  if (stopping && currentSpeed <= 0.5) {
    currentSpeed  = 0;
    motorRunning  = false;
    stopping      = false;
  }

  // Only touch the timer when speed actually changed, to avoid
  // needless re-programming every single loop() pass.
  if (currentSpeed != previousSpeed) {
    applySpeedToTimer();
  }
}

// ── Actuator ramp + move-completion handler ───────────────────
// Similar to updateRamp(), but also watches actStepsRemaining
// (decremented by the ISR every pulse) to know when to start
// ramping down so the move ends at the correct position rather
// than overshooting.
void updateActuatorRamp() {
  unsigned long now = micros();
  if (actLastAccelMicros == 0) actLastAccelMicros = now;
  float dt = (now - actLastAccelMicros) / 1000000.0;
  if (dt <= 0) return;
  actLastAccelMicros = now;

  // Decide if it's time to start decelerating: estimate stopping
  // distance at current speed/decel rate, and start ramping down
  // once remaining steps would be consumed by that deceleration.
  if (actMoving && !actStopping) {
    float stopDistanceSteps = (actCurrentSpeed * actCurrentSpeed) / (2.0 * ACT_ACCEL_STEPS_PER_SEC2);
    if (actStepsRemaining <= (long)stopDistanceSteps || actStepsRemaining <= 0) {
      actTargetSpeed = 0;
      actStopping = true;
    }
  }

  float previousSpeed = actCurrentSpeed;
  float maxChange = ACT_ACCEL_STEPS_PER_SEC2 * dt;

  if (actCurrentSpeed < actTargetSpeed) {
    actCurrentSpeed = min(actCurrentSpeed + maxChange, actTargetSpeed);
  } else if (actCurrentSpeed > actTargetSpeed) {
    actCurrentSpeed = max(actCurrentSpeed - maxChange, actTargetSpeed);
  }

  // Move finished: either ramped to 0 after stopping began, or ran
  // out of steps (covers very short moves that never reach full speed).
  if (actMoving && ((actStopping && actCurrentSpeed <= 0.5) || actStepsRemaining <= 0)) {
    actCurrentSpeed   = 0;
    actStepsRemaining = 0;
    actMoving         = false;
    actStopping       = false;
    applySpeedToActuatorTimer();   // stop the timer cleanly
    Serial.print("✓ Actuator move complete. Position: ");
    Serial.print(ZERO_POS_MM + actPositionSteps * MM_PER_STEP, 2);
    Serial.println(" mm");
  }

  if (actCurrentSpeed != previousSpeed) {
    applySpeedToActuatorTimer();
  }
}

// ── Command parser ───────────────────────────────────────────
void handleCommand(String cmd) {
  cmd.trim();
  cmd.toUpperCase();

  if (cmd.length() == 0) return;

  char action = cmd.charAt(0);

  switch (action) {

    case 'F':   // Forward
    case 'R': { // Reverse
      long speed = cmd.substring(1).toInt();
      if (speed < MIN_SPEED || speed > MAX_SPEED) {
        Serial.print("! Speed out of range (");
        Serial.print(MIN_SPEED);
        Serial.print("–");
        Serial.print(MAX_SPEED);
        Serial.println(" steps/sec)");
        break;
      }

      bool newDir = (action == 'F');

      // If direction is changing while still moving, ramp down to 0 first.
      // Reversing DIR while pulses are flying can cause missed steps.
      if (newDir != dirForward && currentSpeed > 0) {
        Serial.println("… Changing direction: ramping down first");
        targetSpeed = 0;
        stopping    = true;
        // Wait here until fully stopped before reversing.
        // Loop still services Serial during this, so commands aren't lost,
        // but we hold off applying the new direction until speed hits 0.
        while (currentSpeed > 0) {
          BLE.poll();
          updateRamp();
        }
      }

      dirForward = newDir;
      digitalWrite(PIN_DIR, dirForward ? LOW : HIGH);
      delayMicroseconds(5);   // DIR setup time before first pulse

      // Start ramping from START_SPEED if we're at a dead stop,
      // so the very first pulses aren't issued at an unreliable
      // near-zero rate; otherwise ramp from wherever we already are.
      if (currentSpeed < START_SPEED) {
        currentSpeed = START_SPEED;
      }
      targetSpeed   = speed;
      stopping      = false;
      motorRunning  = true;

      Serial.print("▶ ");
      Serial.print(dirForward ? "Forward" : "Reverse");
      Serial.print(" ramping to ");
      Serial.print(speed);
      Serial.println(" steps/sec");
      break;
    }

    case 'S':   // Stop but keep drivers engaged
      targetSpeed = 0;
      stopping    = true;

      actTargetSpeed = 0;
      actStopping    = true;
      Serial.println("■ Stopping both motors (ramping down, drivers remain enabled)");
      break;

    case '?':   // Status
      printStatus();
      break;

    case 'M': {  // Move actuator by <mm> millimeters (can be negative)
      float mm = cmd.substring(1).toFloat();
      if (mm == 0) {
        Serial.println("! M0 is a no-op (specify a nonzero distance)");
        break;
      }
      if (actMoving) {
        Serial.println("! Actuator is already moving — wait for it to finish or it will be ignored");
        break;
      }

      bool moveForward = (mm > 0);
      long steps = (long)round(fabs(mm) / MM_PER_STEP);
      if (steps <= 0) {
        Serial.println("! Distance too small to produce a whole step at current MM_PER_STEP");
        break;
      }

      actDirForward = moveForward;
      digitalWrite(ACT_PIN_DIR, actDirForward ? HIGH : LOW);
      delayMicroseconds(5);   // DIR setup time before first pulse

      // Snap to START_SPEED so the timer fires immediately on the
      // first loop() pass — without this, actCurrentSpeed stays 0,
      // applySpeedToActuatorTimer() never starts the timer, and the
      // move hangs forever waiting for steps that never arrive.
      if (actCurrentSpeed < START_SPEED) {
        actCurrentSpeed = START_SPEED;
      }
      actStepsRemaining = steps;
      actTargetSpeed    = min((float)ACT_MAX_SPEED_STEPS, ACT_CRUISE_SPEED_STEPS);
      actStopping       = false;
      actMoving         = true;
      actLastAccelMicros = 0;   // reset ramp timer so dt doesn't spike on first update
      applySpeedToActuatorTimer();   // kick the timer immediately, don't wait for ramp

      Serial.print("▶ Actuator moving ");
      Serial.print(mm, 2);
      Serial.print(" mm (");
      Serial.print(steps);
      Serial.println(" steps)");
      break;
    }

    case 'P':   // Print current actuator position
      Serial.print("Actuator position: ");
      Serial.print(ZERO_POS_MM + actPositionSteps * MM_PER_STEP, 2);
      Serial.print(" mm  (");
      Serial.print(actPositionSteps);
      Serial.println(" steps from last zero point)");
      break;

    case 'Z': { // Recalibrate: tell the firmware the actuator is
                // physically at <mm> right now.
      String valueText = cmd.substring(1);
      valueText.trim();
      if (valueText.length() == 0) {
        Serial.println("! Z requires a numeric millimeter value, e.g. Z50 or Z-10");
        break;
      }

      float targetMm = valueText.toFloat();
      if (isnan(targetMm) || isinf(targetMm)) {
        Serial.println("! Invalid Z value — use a number in millimeters, e.g. Z50");
        break;
      }

      // The measured physical position becomes the new zero-position
      // reference, and the step count resets to 0 to match it.
      ZERO_POS_MM = targetMm;
      actPositionSteps = 0;

      Serial.print("✓ Actuator position set to ");
      Serial.print(targetMm, 2);
      Serial.print(" mm (ZERO_POS_MM = ");
      Serial.print(ZERO_POS_MM, 2);
      Serial.println(", raw steps reset to 0)");
      break;
    }

    case 'E':
      // Re-enable both drivers, but forcibly zero any motion.
      motorRunning  = false;
      stopping      = false;
      currentSpeed  = 0;
      targetSpeed   = 0;
      applySpeedToTimer();

      actMoving      = false;
      actStopping    = false;
      actCurrentSpeed = 0;
      actTargetSpeed  = 0;
      actStepsRemaining = 0;
      applySpeedToActuatorTimer();

      digitalWrite(PIN_STEP, LOW);
      digitalWrite(PIN_ENA, LOW);
      digitalWrite(ACT_PIN_STEP, LOW);
      digitalWrite(ACT_PIN_ENA, LOW);
      Serial.println("✓ Both drivers enabled; motion set to zero");
      break;

    case 'D':
      // Disable both drivers and stop all motion.
      motorRunning  = false;
      stopping      = false;
      currentSpeed  = 0;
      targetSpeed   = 0;
      applySpeedToTimer();

      actMoving      = false;
      actStopping    = false;
      actCurrentSpeed = 0;
      actTargetSpeed  = 0;
      actStepsRemaining = 0;
      applySpeedToActuatorTimer();

      digitalWrite(PIN_STEP, LOW);
      digitalWrite(PIN_ENA, HIGH);
      digitalWrite(ACT_PIN_STEP, LOW);
      digitalWrite(ACT_PIN_ENA, HIGH);
      Serial.println("○ All drivers disabled (both motors free to turn by hand)");
      break;

    default:
      Serial.print("? Unknown command: ");
      Serial.println(cmd);
      printHelp();
      break;
  }
}

// ── Helpers ──────────────────────────────────────────────────
void printStatus() {
  Serial.println("── Status ──────────────────");
  Serial.print("  Motor   : ");
  Serial.println(motorRunning ? (stopping ? "STOPPING (ramping down)" : "RUNNING") : "STOPPED");
  Serial.print("  Dir     : "); Serial.println(dirForward ? "Forward" : "Reverse");
  Serial.print("  Current : "); Serial.print(currentSpeed, 0); Serial.println(" steps/sec");
  Serial.print("  Target  : "); Serial.print(targetSpeed, 0); Serial.println(" steps/sec");
  Serial.print("  Driver  : ");
  Serial.println(digitalRead(PIN_ENA) == LOW ? "Enabled" : "Disabled");
  Serial.println("  ── Actuator ──");
  Serial.print("  Moving    : ");
  Serial.println(actMoving ? (actStopping ? "STOPPING (ramping down)" : "MOVING") : "IDLE");
  Serial.print("  Position  : "); Serial.print(ZERO_POS_MM + actPositionSteps * MM_PER_STEP, 2); Serial.println(" mm");
  Serial.print("  Steps left: "); Serial.println(actStepsRemaining);
  Serial.print("  Act Driver: ");
  Serial.println(digitalRead(ACT_PIN_ENA) == LOW ? "Enabled" : "Disabled");
  Serial.println("────────────────────────────");
}

void printHelp() {
  Serial.println();
  Serial.println("════ Stepper Control (Serial + BLE) ════");
  Serial.println("  F<n>  Forward  n steps/sec  (e.g. F800)");
  Serial.println("  R<n>  Reverse  n steps/sec  (e.g. R400)");
  Serial.println("  S     Stop both motors, drivers stay enabled");
  Serial.println("  E     Enable both drivers and zero motion");
  Serial.println("  D     Disable both drivers (free by hand)");
  Serial.println("  ?     Print status");
  Serial.println("  Range: 1 – 20000 steps/sec");
  Serial.println("  ── Actuator ──");
  Serial.println("  M<mm> Move actuator by mm, e.g. M50 or M-20");
  Serial.println("  P     Print actuator position");
  Serial.println("  Z<mm> Recalibrate: tell firmware actuator is at <mm> (e.g. Z50 or Z-10)");
  Serial.println("  Same commands work via BLE \"Motor Command\" characteristic");
  Serial.println("  IMU streams on BLE \"Gyro Data\" characteristic (~10Hz)");
  Serial.println("  Format: gx,gy,gz,ax,ay,az (deg/s and g-force)");
  Serial.println("════════════════════════════════════════");
  Serial.println();
}
